## conf/machine/qcs615-adp-air.conf
```bitbake
#@TYPE: Machine
#@NAME: qcs615-adp-air
#@DESCRIPTION: Machine configuration for Qualcomm ADP Air Beta Evaluation Kit (EVK), with QCS615

require conf/machine/include/qcom-qcs615.inc

MACHINE_FEATURES = "usbhost usbgadget alsa wifi bluetooth"

# This DT is available in Linux stable tree, 6.6.y branch.
KERNEL_DEVICETREE:pn-linux-qcom-base = " \
                      qcom/qcs615-ride.dtb \
                      "
```

## conf/machine/qcs6490-rb3gen2-core-kit.conf
```bitbake
#@TYPE: Machine
#@NAME: qcs6490-rb3gen2-core-kit
#@DESCRIPTION: Machine configuration for Qualcomm RB3Gen2 Core Evaluation Kit (EVK), with QCS6490

require conf/machine/include/qcom-qcs6490.inc

MACHINE_FEATURES = "usbhost usbgadget alsa wifi bluetooth"

# This DT currently exist only as patches against linux-qcom-base recipe.
KERNEL_DEVICETREE:pn-linux-qcom-base = " \
                      qcom/qcs6490-rb3gen2.dtb \
                      "

KERNEL_DEVICETREE:pn-linux-qcom-custom = " \
                      qcom/qcs6490-addons-rb3gen2.dtb \
                      qcom/qcs6490-addons-rb3gen2-hsp.dtb \
                      qcom/qcs5430-fp1-addons-rb3gen2.dtb \
                      qcom/qcs5430-fp1-addons-rb3gen2-hsp.dtb \
                      qcom/qcs5430-fp2-addons-rb3gen2.dtb \
                      qcom/qcs5430-fp2-addons-rb3gen2-hsp.dtb \
                      qcom/qcs5430-fp2p5-addons-rb3gen2.dtb \
                      qcom/qcs5430-fp2p5-addons-rb3gen2-hsp.dtb \
                      qcom/qcs5430-fp3-addons-rb3gen2.dtb \
                      qcom/qcs5430-fp3-addons-rb3gen2-hsp.dtb \
                      "

# Additional dtbo to overylay on top of kernel devicetree files
KERNEL_TECH_DTBOS[qcs6490-addons-rb3gen2] = " \
    qcm6490-graphics.dtbo qcm6490-wlan-rb3.dtbo \
    qcm6490-display-rb3.dtbo \
    qcm6490-video.dtbo qcm6490-wlan-upstream.dtbo \
    "
KERNEL_TECH_DTBOS[qcs6490-addons-rb3gen2-hsp] = " \
    qcm6490-wlan-rb3-hsp.dtbo \
    "
KERNEL_TECH_DTBOS[qcs5430-fp1-addons-rb3gen2] = " \
    qcs5430-graphics.dtbo qcm5430-camera-rb3.dtbo \
    qcs5430-wlan-rb3.dtbo \
    qcm6490-display-rb3.dtbo qcm6490-video.dtbo \
    qcs5430-wlan-upstream.dtbo \
    "
KERNEL_TECH_DTBOS[qcs5430-fp1-addons-rb3gen2-hsp] = " \
    "
KERNEL_TECH_DTBOS[qcs5430-fp2-addons-rb3gen2] = " \
    qcs5430-graphics.dtbo qcm5430-camera-rb3.dtbo \
    qcs5430-wlan-rb3.dtbo \
    qcm6490-display-rb3.dtbo qcm6490-video.dtbo \
    qcs5430-wlan-upstream.dtbo \
    "
KERNEL_TECH_DTBOS[qcs5430-fp2-addons-rb3gen2-hsp] = " \
    "
KERNEL_TECH_DTBOS[qcs5430-fp2p5-addons-rb3gen2] = " \
    qcs5430-fp2p5-graphics.dtbo qcm6490-camera-rb3.dtbo \
    qcm6490-display-rb3.dtbo qcs5430-wlan-rb3.dtbo \
    qcs5430-wlan-upstream.dtbo qcm6490-video.dtbo \
    "
KERNEL_TECH_DTBOS[qcs5430-fp2p5-addons-rb3gen2-hsp] = " \
    "
KERNEL_TECH_DTBOS[qcs5430-fp3-addons-rb3gen2] = " \
    qcs5430-fp2p5-graphics.dtbo qcm6490-camera-rb3.dtbo \
    qcm6490-display-rb3.dtbo qcs5430-wlan-rb3.dtbo \
    qcs5430-wlan-upstream.dtbo qcm6490-video.dtbo \
    "
KERNEL_TECH_DTBOS[qcs5430-fp3-addons-rb3gen2-hsp] = " \
    "

# Recipe providers of above dtbo files.
KERNEL_TECH_DTBO_PROVIDERS = "\
    cameradtb \
    qcom-displaydevicetree \
    qcom-graphicsdevicetree \
    qcom-videodtb \
    wlan-devicetree \
"
```

## conf/machine/qcs6490-rb3gen2-industrial-kit.conf
```bitbake
#@TYPE: Machine
#@NAME: qcs6490-rb3gen2-industrial-kit
#@DESCRIPTION: Machine configuration for Qualcomm RB3Gen2 Industrial Evaluation Kit (EVK), with QCS6490

require conf/machine/include/qcom-qcs6490.inc

MACHINE_FEATURES = "usbhost usbgadget alsa wifi bluetooth"

# This DT currently exist only as patches against linux-qcom-base recipe.
KERNEL_DEVICETREE:pn-linux-qcom-base = " \
                      qcom/qcs6490-rb3gen2.dtb \
                      "

KERNEL_DEVICETREE:pn-linux-qcom-custom = " \
                      qcom/qcs6490-addons-rb3gen2-ia-mezz.dtb \
                      "

# Recipe providers of above dtbo files.
KERNEL_TECH_DTBO_PROVIDERS = "\
    cameradtb \
    qcom-displaydevicetree \
    qcom-graphicsdevicetree \
    qcom-videodtb \
    wlan-devicetree \
"

MACHINE_EXTRA_RDEPENDS += " \
    packagegroup-tpm \
"
```

## conf/machine/qcs6490-rb3gen2-vision-kit.conf
```bitbake
#@TYPE: Machine
#@NAME: qcs6490-rb3gen2-vision-kit
#@DESCRIPTION: Machine configuration for Qualcomm RB3Gen2 Evaluation Kit (EVK) with low- and high-resolution CSI cameras, with QCS6490

require conf/machine/include/qcom-qcs6490.inc

MACHINE_FEATURES = "usbhost usbgadget alsa wifi bluetooth"

# This DT currently exist only as patches against linux-qcom-base recipe.
KERNEL_DEVICETREE:pn-linux-qcom-base = " \
                      qcom/qcs6490-rb3gen2.dtb \
                      "

KERNEL_DEVICETREE:pn-linux-qcom-custom = " \
                      qcom/qcs6490-addons-rb3gen2-video-mezz.dtb \
                      qcom/qcs6490-addons-rb3gen2-vision-mezz.dtb \
                      qcom/qcs6490-addons-rb3gen2-vision-mezz-hsp.dtb \
                      qcom/qcs6490-addons-rb3gen2-ptz-mezz.dtb \
                      qcom/qcs6490-addons-rb3gen2-ia-mezz.dtb \
                      qcom/qcs5430-fp1-addons-rb3gen2-vision-mezz.dtb \
                      qcom/qcs5430-fp1-addons-rb3gen2-vision-mezz-hsp.dtb \
                      qcom/qcs5430-fp2-addons-rb3gen2-vision-mezz.dtb \
                      qcom/qcs5430-fp2-addons-rb3gen2-vision-mezz-hsp.dtb \
                      qcom/qcs5430-fp2p5-addons-rb3gen2-vision-mezz.dtb \
                      qcom/qcs5430-fp2p5-addons-rb3gen2-vision-mezz-hsp.dtb \
                      qcom/qcs5430-fp3-addons-rb3gen2-vision-mezz.dtb \
                      qcom/qcs5430-fp2p5-addons-rb3gen2-vision-mezz-hsp.dtb \
                      "

# Additional dtbo to overylay on top of kernel devicetree files
KERNEL_TECH_DTBOS[qcs6490-addons-rb3gen2-video-mezz] = " \
    qcm6490-graphics.dtbo qcm6490-camera-rb3.dtbo \
    qcm6490-display-rb3.dtbo qcm6490-wlan-rb3.dtbo \
    qcm6490-video.dtbo \
    qcm6490-wlan-upstream.dtbo \
    "
KERNEL_TECH_DTBOS[qcs6490-addons-rb3gen2-vision-mezz] = " \
    qcm6490-graphics.dtbo qcm6490-camera-rb3.dtbo \
    qcm6490-display-rb3.dtbo qcm6490-wlan-rb3.dtbo \
    qcm6490-video.dtbo \
    qcm6490-wlan-upstream.dtbo \
    "
KERNEL_TECH_DTBOS[qcs6490-addons-rb3gen2-vision-mezz-hsp] = " \
    qcm6490-wlan-rb3-hsp.dtbo \
    "
KERNEL_TECH_DTBOS[qcs5430-fp1-addons-rb3gen2-vision-mezz] = " \
    qcs5430-graphics.dtbo qcm5430-camera-rb3.dtbo \
    qcs5430-wlan-rb3.dtbo \
    qcm6490-display-rb3.dtbo qcm6490-video.dtbo \
    qcs5430-wlan-upstream.dtbo \
    "
KERNEL_TECH_DTBOS[qcs5430-fp1-addons-rb3gen2-vision-mezz-hsp] = " \
    "
KERNEL_TECH_DTBOS[qcs5430-fp2-addons-rb3gen2-vision-mezz] = " \
    qcs5430-graphics.dtbo qcm5430-camera-rb3.dtbo \
    qcs5430-wlan-rb3.dtbo \
    qcm6490-display-rb3.dtbo qcm6490-video.dtbo \
    qcs5430-wlan-upstream.dtbo \
    "
KERNEL_TECH_DTBOS[qcs5430-fp2-addons-rb3gen2-vision-mezz-hsp] = " \
    "
KERNEL_TECH_DTBOS[qcs5430-fp2p5-addons-rb3gen2-vision-mezz] = " \
    qcs5430-fp2p5-graphics.dtbo qcm6490-camera-rb3.dtbo \
    qcm6490-display-rb3.dtbo qcs5430-wlan-rb3.dtbo \
    qcs5430-wlan-upstream.dtbo qcm6490-video.dtbo \
    "
KERNEL_TECH_DTBOS[qcs5430-fp2p5-addons-rb3gen2-vision-mezz-hsp] = " \
    "
KERNEL_TECH_DTBOS[qcs5430-fp3-addons-rb3gen2-vision-mezz] = " \
    qcs5430-fp2p5-graphics.dtbo qcm6490-camera-rb3.dtbo \
    qcm6490-display-rb3.dtbo qcs5430-wlan-rb3.dtbo \
    qcs5430-wlan-upstream.dtbo qcm6490-video.dtbo \
    "
KERNEL_TECH_DTBOS[qcs5430-fp3-addons-rb3gen2-vision-mezz-hsp] = " \
    "
# Recipe providers of above dtbo files.
KERNEL_TECH_DTBO_PROVIDERS = "\
    cameradtb \
    qcom-displaydevicetree \
    qcom-graphicsdevicetree \
    qcom-videodtb \
    wlan-devicetree \
"
```

## conf/machine/qcs8300-ride-sx.conf
```bitbake
#@TYPE: Machine
#@NAME: qcs8300-ridesx
#@DESCRIPTION: Machine configuration for Qualcomm Ride SX Beta Evaluation Kit (EVK), with qcs8300

require conf/machine/include/qcom-qcs8300.inc

MACHINE_FEATURES = "usbhost usbgadget alsa wifi"

# This DT is available in Linux stable tree, 6.6.y branch.
KERNEL_DEVICETREE:pn-linux-qcom-base = " \
                      qcom/qcs8300-ride.dtb \
                      "

KERNEL_DEVICETREE:pn-linux-qcom-custom = " \
                      qcom/qcs8300-addons-ride.dtb \
                      "

# Additional dtbo to overlay on top of kernel devicetree files
KERNEL_TECH_DTBOS[qcs8300-addons-ride] = " \
    qcs8300-video.dtbo qcs8300-graphics.dtbo \
    qcs8300-camera.dtbo \
    "

# Recipe providers of above dtbo files.
KERNEL_TECH_DTBO_PROVIDERS = "\
    qcom-videodtb \
    qcom-graphicsdevicetree \
    cameradtb \
"
```

## conf/machine/qcs8550.conf
```bitbake
#@TYPE: Machine
#@NAME: qcs8550
#@DESCRIPTION: Machine configuration for the development board, with Qualcomm QCS8550

require conf/machine/include/qcom-qcs8550.inc

MACHINE_FEATURES = "usbhost usbgadget alsa wifi"

KERNEL_IMAGETYPE = "Image"
KERNEL_DEVICETREE = " \
                      qcom/qcs8550-addons-aim300-aiot.dtb \
                      qcom/qcs8550-rb5gen2-hdk.dtb \
                      qcom/sm8550-qrd.dtb \
                      qcom/sm8550-mtp.dtb \
                      "

# Additional dtbo to overlay on top of kernel devicetree files
KERNEL_TECH_DTBOS[qcs8550-addons-aim300-aiot] = "qcs8550-cnss.dtbo qcs8550-display.dtbo qcs8550-graphics.dtbo qcs8550-qps615.dtbo"
KERNEL_TECH_DTBOS[sm8550-qrd] = ""
KERNEL_TECH_DTBOS[sm8550-mtp] = ""

EFI_ARCH = "aa64"
UKI_FILENAME = "uki.efi"
UKI_DTB = "0"

# Additional Kernel cmdline parameters for debug builds
DBG_CMDLINE = "${@oe.utils.conditional('DEBUG_BUILD','1','slub_debug=FZP,zs_handle,zspage; FZPU','',d)}"

# Additional Kernel cmdline parameters for performance optimizations
CONSOLE_CMDLINE = "${@oe.utils.conditional('PERFORMANCE_BUILD','1','console=','console=ttyMSM0,115200n8 earlycon',d)}"

KERNEL_CMDLINE_EXTRA ?= "root=/dev/disk/by-partlabel/system rw rootwait ${CONSOLE_CMDLINE} pcie_pme=nomsi net.ifnames=0 ${DBG_CMDLINE}"

# Disable serial console for performance
SERIAL_CONSOLES = "${@oe.utils.conditional('PERFORMANCE_BUILD','1','','115200;ttyMSM0',d)}"

MACHINE_ESSENTIAL_EXTRA_RRECOMMENDS += " \
    kernel-modules \
"

MACHINE_EXTRA_RDEPENDS += " \
    packagegroup-firmware-qcs8550 \
    wlan-devicetree \
    displaydevicetree \
    graphicsdevicetree \
    qps615-devicetree \
"

KERNEL_MODULE_AUTOLOAD += "realtek"

QCOM_BOOTIMG_ROOTFS ?= "/dev/disk/by-partlabel/system"

OVERLAYFS_ETC_MOUNT_POINT = "/mnt/overlay"
OVERLAYFS_ETC_DEVICE = "/dev/disk/by-partlabel/overlay"
OVERLAYFS_ETC_FSTYPE ?= "ext4"
OVERLAYFS_ETC_USE_ORIG_INIT_NAME = "0"
```

## conf/machine/qcs9075-ride-sx.conf
```bitbake
#@TYPE: Machine
#@NAME: qcs9075-ridesx 
#@DESCRIPTION: Machine configuration for Qualcomm Ride SX Beta Evaluation Kit (EVK), with qcs9075

require conf/machine/include/qcom-qcs9100.inc

MACHINE_FEATURES = "usbhost usbgadget alsa wifi bluetooth"

# This DT is available in Linux stable tree, 6.6.y branch.
KERNEL_DEVICETREE:pn-linux-qcom-base = " \
                      qcom/qcs9100-ride-r3.dtb \
                      "

KERNEL_DEVICETREE:pn-linux-qcom-custom = " \
                      qcom/qcs9075-addons-ride.dtb \
                      qcom/qcs9075-addons-ride-r3.dtb \ 
                      "

# Additional dtbo to overlay on top of kernel devicetree files
KERNEL_TECH_DTBOS[qcs9075-addons-ride] = " \
    sa8775p-video.dtbo qcs9100-graphics.dtbo \
    qcs9075-ride-sx-camera.dtbo \
    "

KERNEL_TECH_DTBOS[qcs9075-addons-ride-r3] = " \
    sa8775p-video.dtbo qcs9100-graphics.dtbo \
    qcs9075-ride-sx-camera.dtbo \
    "

# Recipe providers of above dtbo files.
KERNEL_TECH_DTBO_PROVIDERS = "\
    qcom-graphicsdevicetree \
    qcom-videodtb \
    cameradtb \
"
```

## conf/machine/qcs9100-ride-sx.conf
```bitbake
#@TYPE: Machine
#@NAME: qcs9100-ridesx
#@DESCRIPTION: Machine configuration for Qualcomm Ride SX development platform, with qcs9100

require conf/machine/include/qcom-qcs9100.inc

MACHINE_FEATURES = "usbhost usbgadget alsa wifi bluetooth"

# This DT is available in Linux stable tree, 6.6.y branch.
KERNEL_DEVICETREE:pn-linux-qcom-base = " \
                      qcom/qcs9100-ride.dtb \
                      qcom/qcs9100-ride-r3.dtb \
                      qcom/sa8775p-ride.dtb \
                      qcom/sa8775p-ride-r3.dtb \
                      "

KERNEL_DEVICETREE:pn-linux-qcom-custom = " \
                      qcom/qcs9100-addons-ride.dtb \
                      qcom/qcs9100-addons-ride-r3.dtb \
                      qcom/sa8775p-addons-ride.dtb \
                      qcom/sa8775p-addons-ride-r3.dtb \
                      "

# Additional dtbo to overlay on top of kernel devicetree files
KERNEL_TECH_DTBOS[sa8775p-addons-ride] = " \
    sa8775p-video.dtbo qcs9100-graphics.dtbo \
    qcs9100-camera.dtbo \
    "
KERNEL_TECH_DTBOS[sa8775p-addons-ride-r3] = " \
    sa8775p-video.dtbo qcs9100-graphics.dtbo \
    qcs9100-camera.dtbo \
    "

KERNEL_TECH_DTBOS[qcs9100-addons-ride] = " \
    sa8775p-video.dtbo qcs9100-graphics.dtbo \
    qcs9100-camera.dtbo \
    "

KERNEL_TECH_DTBOS[qcs9100-addons-ride-r3] = " \
    sa8775p-video.dtbo qcs9100-graphics.dtbo \
    qcs9100-camera.dtbo \
    "

# Recipe providers of above dtbo files.
KERNEL_TECH_DTBO_PROVIDERS = "\
    qcom-graphicsdevicetree \
    qcom-videodtb \
    cameradtb \
"
```

## conf/machine/qcs9100.conf
```bitbake
#@TYPE: Machine
#@NAME: qcs9100
#@DESCRIPTION: Machine configuration for the development board, with Qualcomm QCS9100

require conf/machine/include/qcom-qcs9100.inc

MACHINE_FEATURES = "usbhost usbgadget alsa wifi"

KERNEL_IMAGETYPE = "Image"
KERNEL_DEVICETREE = " \
                      qcom/sa8775p-addons-ride.dtb \
                      "

# Additional dtbo to overlay on top of kernel devicetree files
KERNEL_TECH_DTBOS[sa8775p-addons-ride] = "sa8775p-display.dtbo"
KERNEL_TECH_DTBOS[sa8775p-addons-ride] += "sa8775p-video.dtbo"
KERNEL_TECH_DTBOS[sa8775p-addons-ride] += "qcs9100-graphics.dtbo"

EFI_ARCH = "aa64"
UKI_FILENAME = "uki.efi"
UKI_DTB = "0"

# Additional Kernel cmdline parameters for debug builds
DBG_CMDLINE = "${@oe.utils.conditional('DEBUG_BUILD','1','slub_debug=FZP,zs_handle,zspage; FZPU','',d)}"

# Additional Kernel cmdline parameters for performance optimizations
CONSOLE_CMDLINE = "${@oe.utils.conditional('PERFORMANCE_BUILD','1','console=','console=ttyMSM0,115200n8 earlycon',d)}"

KERNEL_CMDLINE_EXTRA ?= "root=/dev/disk/by-partlabel/system rw rootwait ${CONSOLE_CMDLINE} pcie_pme=nomsi net.ifnames=0 pci=noaer ${DBG_CMDLINE}"

MACHINE_ESSENTIAL_EXTRA_RRECOMMENDS += " \
    kernel-modules \
"

MACHINE_EXTRA_RDEPENDS += " \
    packagegroup-firmware-qcs9100 \
    displaydevicetree \
    videodtb \
    graphicsdevicetree \
"
```

## conf/machine/sa8775p-ride-sx.conf
```bitbake
#@TYPE: Machine
#@NAME: Qualcomm SA8775P Ride SX 4.0 Automotive Development Kit
#@DESCRIPTION: Machine configuration for Qualcomm Ride SX development platform, with sa8775p

require conf/machine/include/qcom-qcs9100.inc

MACHINE_FEATURES = "efi usbhost usbgadget alsa wifi"

KERNEL_DEVICETREE ?= " \
                      qcom/sa8775p-ride.dtb \
                      "

MACHINE_ESSENTIAL_EXTRA_RRECOMMENDS += " \
    linux-firmware-qcom-adreno-a663 \
    linux-firmware-qcom-sa8775p-adreno \
"
```
