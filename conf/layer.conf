## conf/layer.conf
```bitbake
# We have a conf and classes directory, add to BBPATH.
BBPATH .= ":${LAYERDIR}"

# We have recipes-* directories, add to BBFILES
BBFILES += "${LAYERDIR}/recipes-*/*/*.bb \
            ${LAYERDIR}/recipes-*/*/*.bbappend"

BBFILE_COLLECTIONS += "qcom-hwe"
BBFILE_PATTERN_qcom-hwe = "^${LAYERDIR}/"
BBFILE_PRIORITY_qcom-hwe = "5"

LAYERDEPENDS_qcom-hwe = "core qcom"
LAYERSERIES_COMPAT_qcom-hwe = "styhead"
```

## conf/machine/include/qcom-base.inc
```bitbake
#Define and add SOC_ARCH to the list of architectures compatible with the given target.
SOC_ARCH = "${@ d.getVar('SOC_FAMILY').replace('-', '_').replace('qcom:', '')}"
PACKAGE_EXTRA_ARCHS:append = "${@['', ' ${SOC_ARCH}']['${SOC_ARCH}' != "${MACHINE_ARCH}"]}"

# Supported BSP selections are: base, custom
# We intend to use 'custom' BSP by default.
# Specific MACHINEs or DISTROs might change this as needed.
QCOM_SELECTED_BSP ??= "custom"
MACHINEOVERRIDES =. "qcom-${QCOM_SELECTED_BSP}-bsp:"

# Set prebuilt pkgs default arch
PBT_ARCH ?= "${SOC_ARCH}"
require conf/machine/include/qcom-prebuilts.inc

# Provider for Graphics Library.
# qcom-base-bsp uses 'mesa' as GL provider
GL_PROVIDER ?= "qcom-adreno"
GL_PROVIDER:qcom-base-bsp ?= "mesa"

PREFERRED_PROVIDER_virtual/egl      = "${GL_PROVIDER}"
PREFERRED_PROVIDER_virtual/libgl    = "${GL_PROVIDER}"
PREFERRED_PROVIDER_virtual/libgles1 = "${GL_PROVIDER}"
PREFERRED_PROVIDER_virtual/libgles2 = "${GL_PROVIDER}"

PREFERRED_PROVIDER_virtual/egl-native      = "mesa-native"
PREFERRED_PROVIDER_virtual/libgl-native    = "mesa-native"
PREFERRED_PROVIDER_virtual/libgles1-native = "mesa-native"
PREFERRED_PROVIDER_virtual/libgles2-native = "mesa-native"

# Provider for libgbm
PREFERRED_PROVIDER_virtual/libgbm ?= "gbm"
PREFERRED_PROVIDER_virtual/libgbm:qcom-base-bsp ?= "mesa"

# Provider for linux kernel
# qcom-base-bsp uses 'linux-qcom-base' as kernel
PREFERRED_PROVIDER_virtual/kernel ?= "linux-qcom-custom"
PREFERRED_PROVIDER_virtual/kernel:qcom-base-bsp ?= "linux-qcom-base"

KERNEL_IMAGETYPE ?= "Image"
KERNEL_ALT_IMAGETYPE ?= "vmlinux"

# Recipe provider for boot critical nhlos bins
PREFERRED_PROVIDER_virtual/bootbins ?= "firmware-qcom-bootbins"

# Recipe provider for disk partition configuration
PREFERRED_PROVIDER_virtual/partconf ?= "firmware-qcom-partconf"

# Use qcom specific version of modemmanger in custom-bsp
PREFERRED_VERSION_modemmanager:qcom-custom-bsp ?= "1.22.0.qcom"
PREFERRED_VERSION_libqmi:qcom-custom-bsp ?= "1.34.0.qcom"
PREFERRED_VERSION_libqrtr-glib:qcom-custom-bsp ?= "1.2.0.qcom"

#Use qcom specific version of wpa-supplicant in custom-bsp
PREFERRED_VERSION_wpa-supplicant:qcom-custom-bsp ?= "2.10.qcom"

# For module signing
INHERIT += " qmodule"

# QDL expects 4096 aligned ext4 image for flashing
IMAGE_FSTYPES = "ext4"
IMAGE_ROOTFS_ALIGNMENT = "4096"
EXTRA_IMAGECMD:ext4 = "-i 4096 -b 4096"

# Mask out tar.gz from IMAGE_FSTYPES
IMAGE_TYPES_MASKED = "tar.gz"

SERIAL_CONSOLE ?= "115200 ttyMSM0"

#
# Below are variables are backport from meta/conf/image-uefi.conf master branch
#
EFI_ARCH = "aa64"

# Location of UKI inside EFI System Partition
EFI_UKI_DIR ?= "/EFI/Linux"
EFI_UKI_PATH = "${EFI_PREFIX}${EFI_UKI_DIR}"

# Use systemd-boot as the EFI bootloader
EFI_PROVIDER = "systemd-boot"

# Install packages at root of ESP
EFI_PREFIX = ""

# Location of dtb inside ESP
EFI_DTB_DIR ?= "${EFI_PREFIX}dtb"

# Unified Kernel Image (UKI) name
EFI_LINUX_IMG ?= "linux-${MACHINE}.efi"

# Place dtb at EFIDTDIR to seamlessly package
KERNEL_DTBDEST = "${EFI_DTB_DIR}"
```

## conf/machine/include/qcom-prebuilts.inc
```bitbake
PBT_ARTIFACTORY ?= "softwarecenter.qualcomm.com/download/software/chip/qualcomm_linux-spf-1-0/qualcomm-linux-spf-1-0_test_device_public"
PBT_BUILD_ID    ?= "r1.0_00054.0"
PBT_BIN_PATH    ?= "le-qclinux-1-0-r1/apps_proc/prebuilt_HY22/${BPN}"
```

## conf/machine/include/qcom-qcm6490.inc
```bitbake
SOC_FAMILY = "qcm6490"
require conf/machine/include/qcom-common.inc

DEFAULTTUNE = "armv8-2a-crypto"
require conf/machine/include/arm/arch-armv8-2a.inc

PREFERRED_PROVIDER_virtual/egl      = "adreno"
PREFERRED_PROVIDER_virtual/libgl    = "adreno"
PREFERRED_PROVIDER_virtual/libgles1 = "adreno"
PREFERRED_PROVIDER_virtual/libgles2 = "adreno"
PREFERRED_PROVIDER_virtual/egl-native      = "mesa-native"
PREFERRED_PROVIDER_virtual/libgl-native    = "mesa-native"
PREFERRED_PROVIDER_virtual/libgles1-native = "mesa-native"
PREFERRED_PROVIDER_virtual/libgles2-native = "mesa-native"

PREFERRED_PROVIDER_virtual/kernel ?= "linux-kernel-qcom"

# Recipe provider for boot critical nhlos bins
PREFERRED_PROVIDER_virtual/bootbins ?= "firmware-qcm6490-boot"

# Fastboot expects an ext4 image, which needs to be 4096 aligned
IMAGE_FSTYPES = "ext4"
IMAGE_ROOTFS_ALIGNMENT = "4096"

EXTRA_IMAGECMD:ext4 = "-i 4096 -b 4096"

MACHINE_ESSENTIAL_EXTRA_RRECOMMENDS += " \
    modemmanager \
    pd-mapper \
    qrtr \
    tqftpserv \
"

MACHINE_EXTRA_RRECOMMENDS += " \
    fastrpc \
    subsystem-ramdump \
"
```

## conf/machine/include/qcom-qcs615.inc
```bitbake
DEFAULTTUNE = "armv8-2a-crypto"
require conf/machine/include/arm/arch-armv8-2a.inc

SOC_FAMILY = "qcs615"
require conf/machine/include/qcom-base.inc

# Additional Kernel cmdline parameters for debug builds
DBG_CMDLINE = "${@oe.utils.conditional('DEBUG_BUILD','1','earlycon nokaslr reboot=panic_warm page_owner=on qcom_scm.download_mode=1 slub_debug=FZP,zs_handle,zspage;FZPU','',d)}"

KERNEL_CMDLINE_EXTRA ?= "pcie_pme=nomsi net.ifnames=0 pci=noaer kpti=off kasan=off kasan.stacktrace=off swiotlb=128 ${DBG_CMDLINE} mitigations=auto kernel.sched_pelt_multiplier=4 rcupdate.rcu_expedited=1 rcu_nocbs=0-7 no-steal-acc vfio_iommu_type1.allow_unsafe_interrupts=1"

MACHINE_ESSENTIAL_EXTRA_RRECOMMENDS += " \
    kernel-modules \
    networkmanager-nmcli \
    pd-mapper \
    qrtr \
    tqftpserv \
"

MACHINE_EXTRA_RDEPENDS += " \
    packagegroup-firmware-qcs615 \
"

MACHINE_EXTRA_RRECOMMENDS:append:qcom-custom-bsp = " \
    fastrpc \
    qcom-subsystem-ramdump \
    trace-cmd \
"
```

## conf/machine/include/qcom-qcs6490.inc
```bitbake
DEFAULTTUNE = "armv8-2a-crypto"
require conf/machine/include/arm/arch-armv8-2a.inc

SOC_FAMILY = "qcm6490"
require conf/machine/include/qcom-base.inc

# Additional Kernel cmdline parameters for debug builds
DBG_CMDLINE = "${@oe.utils.conditional('DEBUG_BUILD','1','earlycon page_owner=on qcom_scm.download_mode=1 slub_debug=FZP,zs_handle,zspage;FZPU','',d)}"

KERNEL_CMDLINE_EXTRA ?= "pcie_pme=nomsi kernel.sched_pelt_multiplier=4 rcupdate.rcu_expedited=1 rcu_nocbs=0-7 kpti=off kasan=off kasan.stacktrace=off no-steal-acc ${DBG_CMDLINE} swiotlb=128 mitigations=auto net.ifnames=0"

MACHINE_ESSENTIAL_EXTRA_RRECOMMENDS += " \
    fastrpc \
    kernel-modules \
    modemmanager \
    pd-mapper \
"

MACHINE_EXTRA_RDEPENDS += " \
    packagegroup-firmware-qcm6490 \
"

MACHINE_EXTRA_RRECOMMENDS:append:qcom-custom-bsp = " \
    kernel-module-wlan-platform \
    kernel-module-qcacld-wlan \
    kernel-module-qca6490 \
    packagegroup-qcom-sensors \
    qcom-subsystem-ramdump \
    securedsp-example \
    wlan-conf \
"
```

## conf/machine/include/qcom-qcs8300.inc
```bitbake
DEFAULTTUNE = "armv8-2a-crypto"
require conf/machine/include/arm/arch-armv8-2a.inc

SOC_FAMILY = "qcs8300"
require conf/machine/include/qcom-base.inc

# Additional Kernel cmdline parameters for debug builds
DBG_CMDLINE = "${@oe.utils.conditional('DEBUG_BUILD','1','earlycon reboot=panic_warm page_owner=on qcom_scm.download_mode=1 slub_debug=FZP,zs_handle,zspage;FZPU','',d)}"

KERNEL_CMDLINE_EXTRA ?= "pcie_pme=nomsi net.ifnames=0 pci=noaer kpti=off kasan=off kasan.stacktrace=off swiotlb=128 ${DBG_CMDLINE} mitigations=auto kernel.sched_pelt_multiplier=4 rcupdate.rcu_expedited=1 rcu_nocbs=0-7 no-steal-acc arm64.nopauth"

MACHINE_ESSENTIAL_EXTRA_RRECOMMENDS += " \
    fastrpc \
    kernel-modules \
    pd-mapper \
    networkmanager-nmcli \
    qrtr \
    tqftpserv \
"

MACHINE_EXTRA_RDEPENDS += " \
    packagegroup-firmware-qcs8300 \
"

MACHINE_EXTRA_RRECOMMENDS:append:qcom-custom-bsp = " \
    qcom-subsystem-ramdump \
    trace-cmd \
    remote-debug-agent \
    securedsp-example \
"
```

## conf/machine/include/qcom-qcs9100.inc
```bitbake
DEFAULTTUNE = "armv8-2a-crypto"
require conf/machine/include/arm/arch-armv8-2a.inc

SOC_FAMILY = "qcs9100"
require conf/machine/include/qcom-base.inc

# Additional Kernel cmdline parameters for debug builds
DBG_CMDLINE = "${@oe.utils.conditional('DEBUG_BUILD','1','earlycon reboot=panic_warm page_owner=on qcom_scm.download_mode=1 slub_debug=FZP,zs_handle,zspage;FZPU','',d)}"

KERNEL_CMDLINE_EXTRA ?= "pcie_pme=nomsi net.ifnames=0 pci=noaer kpti=off kasan=off kasan.stacktrace=off swiotlb=128 ${DBG_CMDLINE} mitigations=auto kernel.sched_pelt_multiplier=4 rcupdate.rcu_expedited=1 rcu_nocbs=0-7 no-steal-acc vfio_iommu_type1.allow_unsafe_interrupts=1 fw_devlink.strict=1"

MACHINE_ESSENTIAL_EXTRA_RRECOMMENDS += " \
    fastrpc \
    kernel-modules \
    pd-mapper \
    networkmanager-nmcli \
    qrtr \
    tqftpserv \
"

MACHINE_EXTRA_RDEPENDS += " \
    packagegroup-firmware-qcs9100 \
"

MACHINE_EXTRA_RRECOMMENDS:append:qcom-custom-bsp = " \
    qcom-subsystem-ramdump \
    trace-cmd \
    remote-debug-agent \
    securedsp-example \
"
```

## conf/machine/include/qcom-sc7280.inc
```bitbake
SOC_FAMILY = "sc7280"
require conf/machine/include/qti-common.inc
DEFAULTTUNE = "armv8-2a-crypto"
require conf/machine/include/arm/arch-armv8-2a.inc

MACHINE_ESSENTIAL_EXTRA_RRECOMMENDS += " \
    pd-mapper \
    qrtr \
    rmtfs \
    tqftpserv \
"

MACHINE_EXTRA_RRECOMMENDS += " \
    fastrpc \
"
```

## conf/machine/include/qti-common.inc
```bitbake
SOC_FAMILY:prepend = "qcom:"
require conf/machine/include/soc-family.inc

PREFERRED_PROVIDER_virtual/kernel = "linux-kernel-qcom"

PREFERRED_PROVIDER_android-tools-conf = "android-tools-conf-configfs"

# Fastboot expects an ext4 image, which needs to be 4096 aligned
IMAGE_FSTYPES = "ext4"
IMAGE_ROOTFS_ALIGNMENT = "4096"

EXTRA_IMAGECMD:ext4 = "-i 4096 -b 4096"

# Boot image settings
QCOM_BOOTIMG_KERNEL_BASE ?= "0x80000000"
QCOM_BOOTIMG_PAGE_SIZE ?= "4096"

# Default serial console for QCOM devices
SERIAL_CONSOLES ?= "115200;ttyMSM0"

# Increase INITRAMFS_MAXSIZE to 384 MiB to cover initramfs-kerneltest-full
# image.
INITRAMFS_MAXSIZE = "393216"
```

## conf/machine/qcm6490-idp.conf
```bitbake
#@TYPE: Machine
#@NAME: qcm6490-idp
#@DESCRIPTION: Machine configuration for the IDP Beta Evaluation Kit (EVK), with Qualcomm QCM6490

require conf/machine/include/qcom-qcs6490.inc

MACHINE_FEATURES = "usbhost usbgadget alsa wifi bluetooth"

# This DT currently exist only as patches against linux-qcom-base recipe.
KERNEL_DEVICETREE:pn-linux-qcom-base = " \
                      qcom/qcm6490-idp.dtb \
                      "

KERNEL_DEVICETREE:pn-linux-qcom-custom = " \
                      qcom/qcm6490-addons-idp.dtb \
                      qcom/qcm6490-addons-idp-amoled.dtb \
                      "

# Additional dtbo to overylay on top of kernel devicetree files
KERNEL_TECH_DTBOS[qcm6490-addons-idp] = " \
    qcm6490-graphics.dtbo qcm6490-display.dtbo \
    qcm6490-camera-idp.dtbo \
    qcm6490-wlan-idp.dtbo qcm6490-video.dtbo \
    qcm6490-wlan-upstream.dtbo \
    "

KERNEL_TECH_DTBOS[qcm6490-addons-idp-amoled] = " \
    qcm6490-graphics.dtbo qcm6490-display-idp-amoled.dtbo \
    qcm6490-camera-idp.dtbo \
    qcm6490-wlan-idp.dtbo qcm6490-video.dtbo \
    qcm6490-wlan-upstream.dtbo \
    "

# Recipe providers of above dtbo files.
KERNEL_TECH_DTBO_PROVIDERS = "\
    cameradtb \
    qcom-displaydevicetree \
    qcom-graphicsdevicetree \
    qcom-videodtb \
    wlan-devicetree \
"
```

## conf/machine/qcm6490.conf
```bitbake
#@TYPE: Machine
#@NAME: qcm6490
#@DESCRIPTION: Machine configuration for the development board, with Qualcomm QCM6490

require conf/machine/include/qcom-qcm6490.inc

MACHINE_FEATURES = "usbhost usbgadget alsa wifi bluetooth"

KERNEL_IMAGETYPE = "Image"
KERNEL_DEVICETREE = " \
                      qcom/qcm6490-addons-idp.dtb \
                      qcom/qcs5430-fp1-addons-rb3gen2.dtb \
                      qcom/qcs5430-fp1-addons-rb3gen2-vision-mezz.dtb \
                      qcom/qcs5430-fp1p5-addons-rb3gen2.dtb \
                      qcom/qcs5430-fp1p5-addons-rb3gen2-vision-mezz.dtb \
                      qcom/qcs5430-fp2-addons-rb3gen2.dtb \
                      qcom/qcs5430-fp2-addons-rb3gen2-vision-mezz.dtb \
                      qcom/qcs6490-addons-rb3gen2.dtb \
                      qcom/qcs6490-addons-rb3gen2-video-mezz.dtb \
                      qcom/qcs6490-addons-rb3gen2-vision-mezz.dtb \
                      qcom/qcs6490-addons-rb3gen2-ptz-mezz.dtb \
                      qcom/qcs6490-addons-rb3gen2-ia-mezz.dtb \
                      "

# Additional dtbo to overylay on top of kernel devicetree files
KERNEL_TECH_DTBOS[qcm6490-addons-idp] = "qcm6490-graphics.dtbo qcm6490-display.dtbo qcm6490-camera.dtbo qcm6490-bt.dtbo qcm6490-wlan-idp.dtbo qcm6490-video.dtbo"
KERNEL_TECH_DTBOS[qcs6490-addons-rb3gen2] = "qcm6490-graphics.dtbo qcm6490-wlan-rb3.dtbo qcm6490-display-rb3.dtbo qcm6490-bt.dtbo qcm6490-video.dtbo"
KERNEL_TECH_DTBOS[qcs6490-addons-rb3gen2-video-mezz] = "qcm6490-graphics.dtbo qcm6490-camera-rb3.dtbo qcm6490-display-rb3.dtbo qcm6490-wlan-rb3.dtbo qcm6490-bt.dtbo qcm6490-video.dtbo"
KERNEL_TECH_DTBOS[qcs6490-addons-rb3gen2-vision-mezz] = "qcm6490-graphics.dtbo qcm6490-camera-rb3.dtbo qcm6490-display-rb3.dtbo qcm6490-wlan-rb3.dtbo qcm6490-bt.dtbo qcm6490-video.dtbo"
KERNEL_TECH_DTBOS[qcs6490-addons-rb3gen2-ptz-mezz] = ""
KERNEL_TECH_DTBOS[qcs6490-addons-rb3gen2-ia-mezz] = ""
KERNEL_TECH_DTBOS[qcs5430-fp1-addons-rb3gen2] = "qcs5430-graphics.dtbo qcm5430-camera-rb3.dtbo qcs5430-wlan-rb3.dtbo qcm6490-bt.dtbo qcm6490-display-rb3.dtbo"
KERNEL_TECH_DTBOS[qcs5430-fp1-addons-rb3gen2-vision-mezz] = "qcs5430-graphics.dtbo qcm5430-camera-rb3.dtbo qcs5430-wlan-rb3.dtbo qcm6490-bt.dtbo qcm6490-display-rb3.dtbo"
KERNEL_TECH_DTBOS[qcs5430-fp1p5-addons-rb3gen2] = "qcs5430-graphics.dtbo qcm5430-camera-rb3.dtbo qcs5430-wlan-rb3.dtbo qcm6490-bt.dtbo qcm6490-display-rb3.dtbo"
KERNEL_TECH_DTBOS[qcs5430-fp1p5-addons-rb3gen2-vision-mezz] = "qcs5430-graphics.dtbo qcm5430-camera-rb3.dtbo qcs5430-wlan-rb3.dtbo qcm6490-bt.dtbo qcm6490-display-rb3.dtbo"
KERNEL_TECH_DTBOS[qcs5430-fp2-addons-rb3gen2] = "qcs5430-graphics.dtbo qcm5430-camera-rb3.dtbo qcs5430-wlan-rb3.dtbo qcm6490-bt.dtbo qcm6490-display-rb3.dtbo"
KERNEL_TECH_DTBOS[qcs5430-fp2-addons-rb3gen2-vision-mezz] = "qcs5430-graphics.dtbo qcm5430-camera-rb3.dtbo qcs5430-wlan-rb3.dtbo qcm6490-bt.dtbo qcm6490-display-rb3.dtbo"

EFI_ARCH = "aa64"
UKI_FILENAME = "uki.efi"
UKI_DTB = "0"

# Additional Kernel cmdline parameters for debug builds
DBG_CMDLINE = "${@oe.utils.conditional('DEBUG_BUILD','1','qcom_scm.download_mode=1 slub_debug=FZP,zs_handle,zspage; FZPU','',d)}"

# Additional Kernel cmdline parameters for performance optimizations
CONSOLE_CMDLINE = "${@oe.utils.conditional('PERFORMANCE_BUILD','1','console=','console=ttyMSM0,115200n8 earlycon',d)}"

KERNEL_CMDLINE_EXTRA ?= "root=/dev/disk/by-partlabel/system rw rootwait ${CONSOLE_CMDLINE} pcie_pme=nomsi kernel.sched_pelt_multiplier=4 rcupdate.rcu_expedited=1 rcu_nocbs=0-7 kpti=off kasan=off kasan.stacktrace=off no-steal-acc page_owner=on ${DBG_CMDLINE} swiotlb=128"

# Disable serial console for performance
SERIAL_CONSOLES = "${@oe.utils.conditional('PERFORMANCE_BUILD','1','','115200;ttyMSM0',d)}"

MACHINE_ESSENTIAL_EXTRA_RRECOMMENDS += " \
    kernel-modules \
"
MACHINE_EXTRA_RDEPENDS += " \
    packagegroup-firmware-qcm6490 \
    graphicsdevicetree \
    displaydevicetree \
    cameradtb \
    wlan-devicetree \
    btdevicetree \
    videodtb \
"

QCOM_BOOTIMG_ROOTFS ?= "/dev/disk/by-partlabel/system"
```
